## boards/shields/dactyl_manuform/Kconfig.shield
```kconfig
# No whitespace after the comma or in the keyboard name!
config SHIELD_DACTYL_MANUFORM_DONGLE
    def_bool $(shields_list_contains,dactyl_manuform_dongle)
```

## boards/shields/prospector/Kconfig.shield
```kconfig
# No whitespace after the comma or in the keyboard name!
config SHIELD_PROSPECTOR_DONGLE
    def_bool $(shields_list_contains,prospector_dongle)
```

## config/west.yml
```yaml
manifest:
  defaults:
    revision: v0.3
  remotes:
    - name: zmkfirmware
      url-base: https://github.com/zmkfirmware
    - name: dactylmanuform
      url-base: https://github.com/JaFettz
    - name: janpfischer
      url-base: https://github.com/janpfischer
  projects:
    - name: zmk
      remote: zmkfirmware
      import: app/west.yml
    - name: zmk-dactly-manuform
      remote: dactylmanuform
      revision: main
    - name: zmk-dongle-screen
      remote: janpfischer
      revision: main
  self:
    path: config
```
